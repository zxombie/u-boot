## configs/bhyve_arm64_defconfig
```kconfig
CONFIG_ARM=y
CONFIG_ARCH_BHYVE=y
CONFIG_HAS_CUSTOM_SYS_INIT_SP_ADDR=y
CONFIG_CUSTOM_SYS_INIT_SP_ADDR=0x100200000
CONFIG_DEFAULT_DEVICE_TREE="bhyve-arm64"
CONFIG_SYS_LOAD_ADDR=0x100000000
CONFIG_PCI=y
CONFIG_SKIP_EARLY_DM=y
CONFIG_EFI_VARIABLE_NO_STORE=y
CONFIG_EFI_VAR_BUF_SIZE=16384
# CONFIG_BOOTMETH_EXTLINUX is not set
# CONFIG_BOOTMETH_EXTLINUX_PXE is not set
CONFIG_DISTRO_DEFAULTS=y
# CONFIG_DISPLAY_CPUINFO is not set
# CONFIG_DISPLAY_BOARDINFO is not set
CONFIG_SYS_MAXARGS=16
# CONFIG_CMD_BOOTM is not set
# CONFIG_CMD_BOOTFLOW is not set
# CONFIG_BOOTM_LINUX is not set
# CONFIG_CMD_ELF is not set
CONFIG_CMD_DM=y
CONFIG_CMD_PCI=y
CONFIG_CMD_POWEROFF=y
# CONFIG_CMD_MII is not set
CONFIG_CMD_NFS=y
CONFIG_OF_CONTROL=y
CONFIG_OF_LIVE=y
CONFIG_OF_BOARD=y
CONFIG_OF_OMIT_DTB=y
CONFIG_DM_WARN=y
# CONFIG_OFNODE_MULTI_TREE is not set
CONFIG_PCIE_ECAM_GENERIC=y
CONFIG_SPECIFY_CONSOLE_INDEX=y
CONFIG_DM_SERIAL=y
CONFIG_PL01X_SERIAL=y
CONFIG_SYSRESET=y
CONFIG_SYSRESET_PSCI=y
CONFIG_VIRTIO_PCI=y
CONFIG_VIRTIO_BLK=y
CONFIG_OF_LIBFDT_ASSUME_MASK=0
# CONFIG_SMBIOS is not set
# CONFIG_TOOLS_MKEFICAPSULE is not set
```
